## conf/distro/nel.conf
```bitbake
# Use O.S. Systems Embedded Linux as base
require conf/distro/oel.conf

### nymea specific settings

DISTRO = "nel"
DISTRO_NAME = "Nymea Embedded Linux"
SDK_VENDOR = "-nelsdk"
SDK_VERSION := "${@'${DISTRO_VERSION}'.replace('snapshot-${DATE}','snapshot')}"
TARGET_VENDOR = "-nel"

# Default to systemd, not sysvinit
DISTRO_FEATURES_append = " systemd"
VIRTUAL-RUNTIME_init_manager = "systemd"
DISTRO_FEATURES_BACKFILL_CONSIDERED += "sysvinit"
VIRTUAL-RUNTIME_initscripts = ""
```
